## CMakeLists.txt
```
cmake_minimum_required (VERSION 3.22)
set(BOARD frdm_k64f)

find_package(Zephyr)
project(Shell-example)

target_sources(app PRIVATE src/main.c)
```

## prj.conf
```kconfig
CONFIG_PRINTK=y
CONFIG_SHELL=y
CONFIG_SHELL_MINIMAL=y
CONFIG_SHELL_LOG_LEVEL_INF=y
CONFIG_SHELL_STACK_SIZE=1024
CONFIG_SHELL_BACKEND_SERIAL=y
CONFIG_SHELL_TAB=y
CONFIG_SHELL_TAB_AUTOCOMPLETION=y
CONFIG_SHELL_CMDS=y
CONFIG_SHELL_HISTORY=y
CONFIG_SHELL_HISTORY_BUFFER=512

# Enable USB stack
CONFIG_USB_DEVICE_STACK=y

# Enable USB Initialize at boot
CONFIG_USB_DEVICE_INITIALIZE_AT_BOOT=y

# USB device descriptors
CONFIG_USB_DEVICE_VID=0x2e8a
CONFIG_USB_DEVICE_PID=0x000a
CONFIG_USB_DEVICE_PRODUCT="Pico"
CONFIG_USB_DEVICE_MANUFACTURER="Raspberry Pi"

# USB configuration descriptors
# To avoid draining the tablet's battery. PicoDRO is designed as a self-powered USB device.
# To do so, D1 is removed from the Raspberry Pi Pico and power is supplied from the VSYS pin.
# That's why, when using the PicoDRO hardware, it should be set as a self-powered USB device.

# Set to "n" for bus-powered devices (powered from the USB host) like the Raspberry Pi Pico.
# Set to "y" for self-powered devices (powered from an external power supply) like PicoDRO hardware.
CONFIG_USB_SELF_POWERED=n

# Depending on your hardware Maximum power consumption needs to be set.
# Set to "125" (250 mA) for the Raspberry Pi Pico (if there is no other external circuitry).
# Set to "1" (2 mA) for the PicoDRO hardware

# Maximum power consumption in 2 mA units
CONFIG_USB_MAX_POWER=125
```

## rpi_pico_w.overlay
```dts
/*
 * Copyright (c) 2022 Mr. Green's Workshop https://www.MrGreensWorkshop.com
 *
 * SPDX-License-Identifier: Apache-2.0
 */

// Use USB CDC as console output.
// Check out the docs: https://docs.zephyrproject.org/latest/services/usb/uds_cdc_acm.html#console-over-cdc-acm-uart
/ {
	chosen {
		zephyr,console = &usb_cdc;
		zephyr,shell = &usb_cdc;
	};
};

&zephyr_udc0 {
	usb_cdc: usb_cdc_0 {
		compatible = "zephyr,cdc-acm-uart";
	};
};
```

## src/main.c
```c
#include <zephyr/kernel.h>
#include <zephyr/drivers/gpio.h>
#include <zephyr/shell/shell.h>
#include <inttypes.h>


/* Specs and Peripherals */
#define LED0_NODE DT_ALIAS(led0)	//Green
#define LED1_NODE DT_ALIAS(led1)	//Blue
#define LED2_NODE DT_ALIAS(led2)	//Red



static const struct gpio_dt_spec green_led = 
	GPIO_DT_SPEC_GET(LED0_NODE, gpios);
	//DEVICE_DT_GET(DT_NODELABEL(gpiob));
static const struct gpio_dt_spec blue_led = 
	GPIO_DT_SPEC_GET(LED1_NODE, gpios);
static const struct gpio_dt_spec red_led = 
	GPIO_DT_SPEC_GET(LED2_NODE, gpios);

//Generic Toggle LED function
static int cmd_toggle_LED(const struct shell *sh, size_t argc, char **argv, void *data)
{
	int val = (intptr_t)data;

	switch (val)
	{
	case 0:
			gpio_pin_toggle_dt(&blue_led);
		break;
	case 1:
			gpio_pin_toggle_dt(&green_led);
		break;
	case 2:
			gpio_pin_toggle_dt(&red_led);
		break;
	default:
			shell_print(sh, "Wrong arg");
		break;
	}

	return 0;
}
//Generic print function
static int cmd_print(const struct shell *sh, size_t argc, char **argv)
{

		shell_print(sh, "Command received");
		return 0;

}

static int cmd_stdalone(const struct shell *sh, size_t argc, char **argv)
{
	shell_print(sh, "Standalone Command");
	return 0;
}

//Creating a subcommand dictionary
SHELL_SUBCMD_DICT_SET_CREATE(sub_toggle_cmds, cmd_toggle_LED,
	(value_0, 0, "value 0"), (value_1, 1, "value 1"),
	(value_2, 2, "value 2"), (value_3, 3, "value 3")
);
//Creating a subcmd set 
SHELL_STATIC_SUBCMD_SET_CREATE(sub_demo,
	SHELL_CMD(prt, NULL, "Print", &cmd_print),
	SHELL_CMD(tog, &sub_toggle_cmds, "Toggle LED", NULL)
);

//Create a command with its subcmds
SHELL_CMD_REGISTER(demo, &sub_demo, "Demo commands", NULL);
//Create a standalone cmd that don't have any subcmds
SHELL_CMD_REGISTER(stdal, NULL, "Stand Alone Command", &cmd_stdalone);

void main(void)
{
	int ret;
	if(!gpio_is_ready_dt(&blue_led))
		printk("Could not start blue_led port\n");

	ret = gpio_pin_configure_dt(&blue_led, GPIO_OUTPUT_INACTIVE);
	if(ret != 0)
		return;
	
	if(!gpio_is_ready_dt(&green_led))
		printk("Could not start green_led port\n");

	ret = gpio_pin_configure_dt(&green_led, GPIO_OUTPUT_INACTIVE);
	if(ret != 0)
		return;

	if(!gpio_is_ready_dt(&red_led))
		printk("Could not start red_led port\n");

	ret = gpio_pin_configure_dt(&red_led, GPIO_OUTPUT_INACTIVE);
	if(ret != 0)
		return;

		
}
```
