
/*
 * Copyright (c) 2023 Espressif Systems (Shanghai) Co., Ltd.
 *
 * SPDX-License-Identifier: Apache-2.0
 */

&i2c0 {
	status = "okay";
	clock-frequency = <I2C_BITRATE_FAST>;
	sda-gpios = <&gpio0 21 (GPIO_OPEN_DRAIN  )>;
	scl-gpios = <&gpio0 22 (GPIO_OPEN_DRAIN  )>;
	pinctrl-0 = <&i2c0_default>;
	pinctrl-names = "default";
	
	bme280: bme280@76 {
		compatible = "bosch,bme280";
		reg = <0x76>;
	};	
};
