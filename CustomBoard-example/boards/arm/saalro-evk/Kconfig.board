## CustomBoard-example/boards/arm/saalro-evk/Kconfig.board
```kconfig
# SAALRO-EVK board configuration

# Copyright (c) 2017 Linaro Limited
# SPDX-License-Identifier: Apache-2.0

config SAALRO-EVK
	bool "SAALRO-EVK F429BI Development Board"
	depends on SOC_STM32F429XX
```

## CustomBoard-example/boards/arm/saalro-evk/Kconfig.defconfig
```kconfig
# NUCLEO-144 F429ZI board configuration

# Copyright (c) 2017 Linaro Limited
# SPDX-License-Identifier: Apache-2.0

if SAALRO-EVK

config BOARD
	default "saalro-evk"

if NETWORKING

config NET_L2_ETHERNET
	default y

endif # NETWORKING

endif # BOARD_NUCLEO_F429ZI
```

## CustomBoard-example/boards/arm/saalro-evk/saalro-evk_defconfig
```kconfig
CONFIG_SOC_SERIES_STM32F4X=y
CONFIG_SOC_STM32F429XX=y                      /* select your SoC */

# Enable MPU
CONFIG_ARM_MPU=y

CONFIG_SERIAL=y
```

## tutorial/boards/frdm_kl26z/Kconfig.board
```kconfig
# FRDM-KL26Z board

# Copyright (c) 2017, NXP
# SPDX-License-Identifier: Apache-2.0

config BOARD_FRDM_KL26Z
	bool "NXP FRDM-KL26Z"
	depends on SOC_SERIES_KINETIS_KL2X
	select SOC_PART_NUMBER_MKL25Z128VLK4
```
