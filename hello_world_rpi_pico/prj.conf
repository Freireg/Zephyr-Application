## prj.conf
```kconfig
# nothing here
# Enable USB stack
CONFIG_USB_DEVICE_STACK=y

# Enable USB Initialize at boot
CONFIG_USB_DEVICE_INITIALIZE_AT_BOOT=y

# USB device descriptors
# CONFIG_USB_DEVICE_VID=0x2e8a
# CONFIG_USB_DEVICE_PID=0x000a
# CONFIG_USB_DEVICE_PRODUCT="Pico"
# CONFIG_USB_DEVICE_MANUFACTURER="Raspberry Pi"

# USB configuration descriptors
# To avoid draining the tablet's battery. PicoDRO is designed as a self-powered USB device.
# To do so, D1 is removed from the Raspberry Pi Pico and power is supplied from the VSYS pin.
# That's why, when using the PicoDRO hardware, it should be set as a self-powered USB device.

# Set to "n" for bus-powered devices (powered from the USB host) like the Raspberry Pi Pico.
# Set to "y" for self-powered devices (powered from an external power supply) like PicoDRO hardware.
CONFIG_USB_SELF_POWERED=n

# Depending on your hardware Maximum power consumption needs to be set.
# Set to "125" (250 mA) for the Raspberry Pi Pico (if there is no other external circuitry).
# Set to "1" (2 mA) for the PicoDRO hardware

# Maximum power consumption in 2 mA units
CONFIG_USB_MAX_POWER=125
```

## src/main.c
```c
/*
 * Copyright (c) 2012-2014 Wind River Systems, Inc.
 *
 * SPDX-License-Identifier: Apache-2.0
 */

#include <zephyr/kernel.h>

int main(void)
{
	while(1){
	
	printk("Hello World! %s\n", CONFIG_BOARD);
	k_msleep(1000);
	}
	return 0;
}
```
